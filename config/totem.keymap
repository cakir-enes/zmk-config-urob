/* source keypos definitions */
#include "../zmk-nodefree-config/keypos_def/keypos_totem.h"

/* map Totem's extra keys */
#define X_LB  &kp ESC
#define X_RB  &sk LC(LA(LSHIFT))
#define X_LH  &smart_mouse  // thumb row, left
#define X_RH  SMART_NUM // thumb row, right
#define NAV_BSPC  &mt LA(BSPC) BSPC    // tap: bspc  | long-tap: delete word backward

/* activate bluetooth */
#define CONFIG_WIRELESS 1

/* source the main keymap */
#include "base.keymap"

